## arch/mips/arch-lantiq/Kconfig
```kconfig
menu "Lantiq platform"
	depends on ARCH_LANTIQ

config SYS_SOC
	default "xrx200" if SOC_XWAY_XRX200

choice
	prompt "Lantiq SoC select"

config SOC_XWAY_XRX200
	bool "Lantiq XWAY XRX200 family"
	select SUPPORTS_BIG_ENDIAN
	select SUPPORTS_CPU_MIPS32_R1
	select SUPPORTS_CPU_MIPS32_R2
	help
	  This supports Lantiq XWAY XRX200 family including VRX220, VRX268
	  and VRX288.

endchoice

choice
	prompt "Board select"

config TARGET_EASY80920
	bool "Lantiq EASY80920"
	depends on SOC_XWAY_XRX200
	select LANTIQ_SUPPORTS_BOOT_RAM

endchoice

choice
	prompt "Boot mode"

config LANTIQ_BOOT_RAM
	bool "RAM boot"
	depends on LANTIQ_SUPPORTS_BOOT_RAM
	help
	  This builds an image that is linked to a RAM address. Caches are
	  disabled and environment is built in. The RAM boot mode is suited for
	  use with EJTAG.

endchoice

config LANTIQ_SUPPORTS_BOOT_RAM
	bool
	select CPU_DISABLE_CACHES

source "board/lantiq/easy80920/Kconfig"

endmenu
```

## board/lantiq/easy50712/Kconfig
```kconfig
if TARGET_EASY50712

config SYS_BOARD
	default "easy50712"

config SYS_VENDOR
	default "lantiq"

config SYS_CONFIG_NAME
	default "easy50712"

endif
```

## board/lantiq/easy80920/Kconfig
```kconfig
if TARGET_EASY80920

config SYS_BOARD
	default "easy80920"

config SYS_VENDOR
	default "lantiq"

config SYS_CONFIG_NAME
	default "easy80920"

endif
```

## configs/easy50712_ram_defconfig
```kconfig
CONFIG_MIPS=y
CONFIG_ARCH_LANTIQ=y
CONFIG_SOC_XWAY_DANUBE=y
CONFIG_TARGET_EASY50712=y
CONFIG_LANTIQ_BOOT_RAM=y

CONFIG_DM=y
CONFIG_DM_SERIAL=y
CONFIG_LANTIQ_SERIAL=y

# CONFIG_CMD_BOOTM is not set
# CONFIG_CMD_GO is not set
# CONFIG_CMD_EXPORTENV is not set
# CONFIG_CMD_IMPORTENV is not set
# CONFIG_CMD_CRC32 is not set
```

## configs/easy80920_ram_defconfig
```kconfig
CONFIG_MIPS=y
CONFIG_ARCH_LANTIQ=y
CONFIG_SOC_XWAY_XRX200=y
CONFIG_TARGET_EASY80920=y
CONFIG_LANTIQ_BOOT_RAM=y

CONFIG_DM=y
CONFIG_DM_SERIAL=y
CONFIG_LANTIQ_SERIAL=y

# CONFIG_CMD_BOOTM is not set
# CONFIG_CMD_GO is not set
# CONFIG_CMD_EXPORTENV is not set
# CONFIG_CMD_IMPORTENV is not set
# CONFIG_CMD_CRC32 is not set
```
